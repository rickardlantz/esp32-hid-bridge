## main/Kconfig.projbuild
```kconfig
menu "Keyboard bridge"
    choice BRIDGE_BOARD
        prompt "Board model"
        default BRIDGE_BOARD_LCD_147
        config BRIDGE_BOARD_LCD_147
            bool "ESP32-S3-LCD-1.47 (USB-A)"
        config BRIDGE_BOARD_LCD_147B
            bool "ESP32-S3-LCD-1.47B (USB-C, onboard QMI8658)"
    endchoice
    config BRIDGE_KEYBOARD_NAME
        string "Exact BLE keyboard name (empty selects first keyboard)"
        default ""
        help
            Set this before pairing when multiple keyboards are nearby.
            The selected peer address is remembered in NVS.
    config BRIDGE_QMI8658
        bool "Enable optional QMI8658 accelerometer"
        default y if BRIDGE_BOARD_LCD_147B
        default n
        help
            The 1.47B has an onboard QMI8658. This option remains optional.
            The USB-A ESP32-S3-LCD-1.47 has no onboard accelerometer.
            On USB-A, enable only with an external QMI8658 on the configured header pins.
            Missing/unresponsive hardware falls back to the portrait layout.
    if BRIDGE_QMI8658
        config BRIDGE_IMU_SDA
            int "Accelerometer SDA GPIO"
            range 0 48
            default 48 if BRIDGE_BOARD_LCD_147B
            default 1
        config BRIDGE_IMU_SCL
            int "Accelerometer SCL GPIO"
            range 0 48
            default 47 if BRIDGE_BOARD_LCD_147B
            default 2
        config BRIDGE_IMU_ADDRESS
            hex "QMI8658 I2C address"
            range 0x6a 0x6b
            default 0x6b
        config BRIDGE_IMU_SWAP_XY
            bool "Swap accelerometer X/Y to match screen axes"
            default n
        config BRIDGE_IMU_INVERT_X
            bool "Invert screen X acceleration"
            default n
        config BRIDGE_IMU_INVERT_Y
            bool "Invert screen Y acceleration"
            default n
    endif
endmenu
```

## sdkconfig.defaults
```kconfig
CONFIG_IDF_TARGET="esp32s3"
CONFIG_BT_ENABLED=y
CONFIG_BT_BLUEDROID_ENABLED=y
CONFIG_BT_BLE_ENABLED=y
CONFIG_BT_BLE_42_FEATURES_SUPPORTED=y
CONFIG_BT_GATTC_NOTIF_REG_MAX=16
CONFIG_TINYUSB_HID_COUNT=1
CONFIG_TINYUSB_CDC_ENABLED=y
CONFIG_TINYUSB_MSC_ENABLED=y
CONFIG_TINYUSB_MSC_BUFSIZE=4096
CONFIG_PARTITION_TABLE_CUSTOM=y
CONFIG_PARTITION_TABLE_CUSTOM_FILENAME="partitions.csv"
CONFIG_ESP_CONSOLE_UART_DEFAULT=y
CONFIG_ESPTOOLPY_FLASHSIZE_16MB=y
CONFIG_WL_SECTOR_SIZE_512=y
CONFIG_WL_SECTOR_MODE_SAFE=y
CONFIG_FREERTOS_HZ=1000
CONFIG_SPIRAM=y
CONFIG_SPIRAM_MODE_OCT=y
CONFIG_SPIRAM_SPEED_80M=y
CONFIG_SPIRAM_USE_MALLOC=y
CONFIG_MBEDTLS_SSL_KEEP_PEER_CERTIFICATE=y
CONFIG_ESP_COEX_SW_COEXIST_ENABLE=y
CONFIG_TINYUSB_DESC_BCD_DEVICE=0x0200
```
